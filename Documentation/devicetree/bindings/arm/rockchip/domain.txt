## Documentation/devicetree/bindings/arm/rockchip/domain.txt
```
* Rockchip Power Domains

Rockchip processors include support for multiple power domains which can be power
up/down by software based on different application scenes to save power.

Required properties for power domain controller:
- compatible: should be one of the following.
    * rockchip,rk3288-power-domain - for rk3288 type power domain.
- #rockchip,power-domain-cells: Number of cells in a power-domain specifier.
				should be 1.
- rockchip,pmu: phandle referencing a syscon providing the pmu registers

Required properties for power domain sub nodes:
- clocks: phandles to clocks which need to be enalbed when power domain swithes state.
- rockchip,pd-id: index of the power domain, should use macro in
                  include/dt-bindings/domain/rockchip.h

Example:

	power: power-domain {
	       compatible = "rockchip,rk3288-power-domain";
	       #rockchip,power-domain-cells = <1>;
	       rockchip,pmu = <&pmu>;

	       pd_gpu {
	               clocks = <&cru ACLK_GPU>;
	               rockchip,pd-id = <RK3288_PD_GPU>;
	       };
	};

Node of a device using power domains must have a rockchip,power-domain property,
containing a phandle to the power device node and an index specifying which power
domain to use. The index should use macro in include/dt-bindings/domain/rockchip.h

Example of the node using power domain:

	node {
		/* ... */
		rockchip,power-domain = <&power RK3288_PD_GPU>;
		/* ... */
	};
```

## Documentation/devicetree/bindings/mfd/rk808.txt
```
RK808 Power Management Integrated Circuit

Required properties:
- compatible: "rockchip,rk808"
- reg: I2C slave address
- interrupt-parent: The parent interrupt controller.
- interrupts: the interrupt outputs of the controller.
- pinctrl-names: Should contain only one value - "default".
- pinctrl-0: Should specify pin control groups used for this controller.
- regulators: This is the list of child nodes that specify the regulator
  initialization data for defined regulators. Not all regulators for the given
  device need to be present. The definition for each of these nodes is defined
  using the standard binding for regulators found at
  Documentation/devicetree/bindings/regulator/regulator.txt.

Optional properties:
- rockchip,system-power-controller: Telling whether or not this pmic is controlling
  the system power.

Example:
rk808: pmic@1b {
	compatible = "rockchip,rk808";
	interrupt-parent = <&gpio0>;
	interrupts = <4 IRQ_TYPE_EDGE_FALLING>;
	pinctrl-names = "default";
	pinctrl-0 = <&pmic_int>;
	reg = <0x1b>;
	rk808,system-power-controller;

		regulators {
			rk808_dcdc1_reg: DCDC_REG1 {
				regulator-always-on;
				regulator-boot-on;
				regulator-min-microvolt = <1200000>;
				regulator-max-microvolt = <1200000>;
				regulator-name = "vdd_arm";
			};

			rk808_dcdc2_reg: DCDC_REG2 {
				regulator-always-on;
				regulator-boot-on;
				regulator-min-microvolt = <850000>;
				regulator-max-microvolt = <1250000>;
				regulator-name = "vdd_gpu";
			};

			rk808_dcdc3_reg: DCDC_REG3 {
				regulator-always-on;
				regulator-boot-on;
				regulator-name = "vdd_ddr";
			};

			rk808_dcdc4_reg: DCDC_REG4 {
				regulator-always-on;
				regulator-boot-on;
				regulator-min-microvolt = <3300000>;
				regulator-max-microvolt = <3300000>;
				regulator-name = "vccio";
			};

			rk808_ldo1_reg: LDO_REG1 {
				regulator-always-on;
				regulator-boot-on;
				regulator-min-microvolt = <3300000>;
				regulator-max-microvolt = <3300000>;
			};

			rk808_ldo2_reg: LDO_REG2 {
				regulator-always-on;
				regulator-boot-on;
				regulator-min-microvolt = <3300000>;
				regulator-max-microvolt = <3300000>;
			};

			rk808_ldo3_reg: LDO_REG3 {
				regulator-always-on;
				regulator-boot-on;
				regulator-min-microvolt = <1000000>;
				regulator-max-microvolt = <1000000>;
				regulator-name = "LDO_REG3";
			};

			rk808_ldo4_reg: LDO_REG4 {
				regulator-always-on;
				regulator-boot-on;
				regulator-min-microvolt = <1800000>;
				regulator-max-microvolt = <1800000>;
			};

			rk808_ldo5_reg: LDO_REG5 {
				regulator-always-on;
				regulator-boot-on;
				regulator-min-microvolt = <1800000>;
				regulator-max-microvolt = <3300000>;
			};

			rk808_ldo6_reg: LDO_REG6 {
				regulator-always-on;
				regulator-boot-on;
				regulator-min-microvolt = <1000000>;
				regulator-max-microvolt = <1000000>;
			};

			rk808_ldo7_reg: LDO_REG7 {
				regulator-always-on;
				regulator-boot-on;
				regulator-min-microvolt = <1800000>;
				regulator-max-microvolt = <1800000>;
			};

			rk808_ldo8_reg: LDO_REG8 {
				regulator-always-on;
				regulator-boot-on;
				regulator-min-microvolt = <3300000>;
				regulator-max-microvolt = <3300000>;
			};

			rk808_switch1_reg: SWITCH_REG1 {
				regulator-always-on;
				regulator-boot-on;
			};

			rk808_switch2_reg: SWITCH_REG2 {
				regulator-always-on;
				regulator-boot-on;
			};
		};
	};
```

## Documentation/devicetree/bindings/panel/panel,b101ew05.txt
```
LVDS 1280x800 panel

Required properties:
- compatible: should be "panel,b101ew05"

This binding is compatible with the simple-panel binding, which is specified
in simple-panel.txt in this directory.
```

## Documentation/devicetree/bindings/panel/panel,lp097qx1.txt
```
EDP 1536x2048 panel

Required properties:
- compatible: should be "panel,lp097qx1"

This binding is compatible with the simple-panel binding, which is specified
in simple-panel.txt in this directory.
```

## Documentation/devicetree/bindings/panel/panel,n116bge.txt
```
EDP 1366x768 panel

Required properties:
- compatible: should be "panel,n116bge"

This binding is compatible with the simple-panel binding, which is specified
in simple-panel.txt in this directory.
```

## Documentation/devicetree/bindings/sound/rockchip,rockchip-audio-max98090.txt
```
ROCKCHIP audio complex, with MAX98090 CODEC

Required properties:
- compatible : "rockchip,rockchip-audio-max98090"
- rockchip,audio-routing : A list of the connections between audio components.
  Each entry is a pair of strings, the first being the connection's sink,
  the second being the connection's source. Valid names for sources and
  sinks are the MAX98090's pins (as documented in its binding), and the jacks
  on the board:

  * Headphones
  * Speakers
  * Mic Jack

- rockchip,i2s-controller : The phandle of the Tegra I2S controller that's
  connected to the CODEC.
- rockchip,audio-codec : The phandle of the MAX98090 audio codec.

Optional properties:
- rockchip,hp-det-gpios : The GPIO that detect headphones are plugged in
- rockchip,mic-det-gpios : The GPIO that detect micphones are plugged in

Example:

sound {
	compatible = "rockchip,rockchip-audio-max98090-veyron",
		     "rockchip,rockchip-audio-max98090";
	nvidia,model = "ROCKCHIP-I2S";

	nvidia,audio-routing =
		"Headphones", "HPR",
		"Headphones", "HPL",
		"Speakers", "SPKR",
		"Speakers", "SPKL",
		"Mic Jack", "MICBIAS",
		"IN34", "Mic Jack";

	nvidia,i2s-controller = <&i2s>;
	nvidia,audio-codec = <&max98090>;
};
```

## Documentation/devicetree/bindings/thermal/rockchip-thermal.txt
```
* Temperature Sensor ADC (TSADC) on rockchip SoCs

Required properties:
- compatible : "rockchip,rk3288-tsadc"
- reg : physical base address of the controller and length of memory mapped
  region.
- interrupts : The interrupt number to the cpu. The interrupt specifier format
  depends on the interrupt controller.
- clocks : Must contain an entry for each entry in clock-names.
- clock-names : Shall be "tsadc_clk" for the transfer-clock, and "tsadc_pclk" for
    the peripheral clock.
Optional properties:
- clock-frequency : Thermal sensor's clock frequency.
- pinctrl-names : Should contain only one value - "default".
- pinctrl-0 : Should contain only one value - &tsadc_int.
- passive-temp : Temperature of trip 0.
- critical-temp : Temperature of trip 1.
- force-shut-temp : Temperature of force shut down.
Example:

tsadc: tsadc@ff280000 {
	compatible = "rockchip,rk3288-tsadc";
	reg = <0xff280000 0x100>;
	interrupts = <GIC_SPI 37 IRQ_TYPE_LEVEL_HIGH>;
	clock-frequency = <10000>;
	clocks = <&cru SCLK_TSADC>, <&cru PCLK_TSADC>;
	clock-names = "tsadc_clk", "tsadc_pclk";
	pinctrl-names = "default";
	pinctrl-1 = <&tsadc_int>;
	passive-temp = <80>;
	critical-temp = <100>;
	force-shut-temp = <120>;
};
```

## Documentation/devicetree/bindings/video/rockchip-dp.txt
```
The Rockchip display port interface should be configured based on
the type of panel connected to it.

For the Panel initialization, we read data from dp-controller node.
Required properties for dp:
-compatible: value should be one of the following
		"rockchip,rk32xx-lvds";
		"rockchip,rk32xx-edp";
		"rockchip,rk3288-hdmi";

- rockchip,grf: this soc should set GRF regs, so need get grf here.

- reg: physical base address of the controller and length

- clocks: from common clock binding: handle to dp clock.
		of memory mapped region.
- clock-names: from common clock binding: Shall be "pclk_lvds".
		pclk_lvds: for power domain, if it disable soc will power down

Example:
SOC specific portion:
	lvds: lvds@ff96c000 {
		compatible = "rockchip,rk32-lvds";
		rockchip,grf = <&grf>;
		reg = <0xff96c000 0x4000>;
		clocks = <&cru PCLK_LVDS_PHY>;
		clock-names = "pclk_lvds";
	};
```

## Documentation/devicetree/bindings/video/rockchip-edp.txt
```
Rockchip RK3288 EDP interface
================================

Required properties:
- compatible: "rockchip,rk3288-edp";

- reg: physical base address of the controller and length
- clocks: from common clock binding: handle to dp clock.
	of memory mapped region.
- clock-names: from common clock binding:
	Required elements: "clk_edp"
			"clk_edp_24m"
			"clk_edp_24m_parent"
			"pclk_edp"
- resets: Must contain an entry for each entry in reset-names.
	See ../reset/reset.txt for details.
- reset-names: Must include the name "edp"

- rockchip,grf: this soc should set GRF regs, so need get grf here.
- rockchip,panel: required a simple panel node as described by
	Documentation/devicetree/bindings/panel/simple-panel.txt
Example:
	edp: edp@ff970000 {
		compatible = "rockchip,rk3288-edp";
		reg = <0xff970000 0x4000>;
		interrupts = <GIC_SPI 98 IRQ_TYPE_LEVEL_HIGH>;
		clocks = <&cru SCLK_EDP>, <&cru SCLK_EDP_24M>, <&cru PCLK_EDP_CTRL>, <&xin24m>;
		clock-names = "clk_edp", "clk_edp_24m", "pclk_edp", "clk_edp_24m_parent";
		rockchip,grf = <&grf>;
		resets = <&cru 111>;
		reset-names = "edp";
		rockchip,panel = <&panel>;
	};
```

## Documentation/devicetree/bindings/video/rockchip-lcdc.txt
```
Device-Tree bindings for Rockchip SoC display controller (LCDC)

LCDC (LCD Controller) is the Display Controller for the Rockchip
series of SoCs which transfers the image data from a video memory
buffer to an external LCD interface.

Required properties:
- compatible: value should be one of the following
		"rockchip,rk3066-lcdc";
		"rockchip,rk3188-lcdc";
		"rockchip,rk3288-lcdc";

- interrupts: should contain a list of all LCDC IP block interrupts in the
		 order: VSYNC, LCD_SYSTEM. The interrupt specifier
		 format depends on the interrupt controller used.

- clocks: must include clock specifiers corresponding to entries in the
		clock-names property.

- clock-names: Must contain
		aclk_lcdc: for ddr buffer transfer.
		hclk_lcdc: for ahb bus to R/W the phy regs.
		dclk_lcdc: pixel clock.

Example:
SoC specific DT entry:
	lcdc1: lcdc@ff940000 {
		compatible = "rockchip,rk3288-lcdc";
		reg = <0xff940000 0x10000>;
		interrupts = <GIC_SPI 16 IRQ_TYPE_LEVEL_HIGH>;
		clocks = <&cru ACLK_LCDC1>, <&cru DCLK_LCDC1>, <&cru HCLK_LCDC1>;
		clock-names = "aclk_lcdc", "dclk_lcdc", "hclk_lcdc";
	};
```

## Documentation/devicetree/bindings/video/rockchip-lvds.txt
```
Rockchip RK3288 LVDS interface
================================
Required properties:
- compatible: "rockchip,rk3288-lvds";

- reg: physical base address of the controller and length

- clocks: from common clock binding: handle to dp clock.
	of memory mapped region.
- clock-names: from common clock binding: Shall be "pclk_lvds".
	pclk_lvds: for power domain, if it disable soc will power down

- rockchip,grf: this soc should set GRF regs, so need get grf here.
- rockchip,data-mapping: should be "vesa" or "jeida"
	This describes how the color bits are laid out in the
	serialized LVDS signal.

- rockchip,data-width: should be <18> or <24>

- rockchip,display: a display node as described by
	Documentation/devicetree/bindings/video/rockchip-display.txt

- rockchip,panel: required a simple panel node as described by
	Documentation/devicetree/bindings/panel/simple-panel.txt

Example:
SOC specific portion:
	lvds: lvds@ff96c000 {
		compatible = "rockchip,rk3288-lvds";
		reg = <0xff96c000 0x4000>;
		clocks = <&cru PCLK_LVDS_PHY>;
		clock-names = "pclk_lvds";

		rockchip,grf = <&grf>;
		rockchip,data-mapping = "jeida";
		rockchip,data-width = <24>;
		rockchip,panel = <&panel>
	};
```

## Documentation/devicetree/bindings/video/rockchip-panel.txt
```
Rockchip LCD Display interface
================================
Required properties:
-compatible: "rockchip,rockchip-panel";

- rockchip,output-face: lcdc display mode value should set as following
		"r8g8b8": 24bit display port, R8 G8 B8
		"r6g6b6": 18bit display port, R6 G6 B6
		"r5g6b5": 16bit display port, R5 G6 B5


Optional properties:
- display-timings: timings for the connected panel as described by
	Documentation/devicetree/bindings/video/display-timing.txt
Optional properties:
- rockchip,power-gpios: gpio to power on or off the LCD (as many as needed)
- lcdc-vcc18: Defined if power supply of lcd controller is 1.8v,
		Not defined if power supply of lcd controller is 3.3v.
- output-dither: support dithering the output color.
- color-swap-rb: swap R and B color per pixel.
- color-swap-rg: swap R and G color per pixel.
- color-swap-bg: swap B and G color per pixel.

Example:
	panel {
		compatible = "rockchip,rockchip-panel";
		rockchip,output-face = "r6g6b6"

		enable-gpios = <&gpio7 3 GPIO_ACTIVE_HIGH>
		output-dither;

		display-timings {
			native-mode = <&timing_disp0>;

			timing_disp0: 1280x800 {
				clock-frequency = <71000000>;
				hactive = <1280>;
				vactive = <800>;
				hback-porch = <100>;
				hfront-porch = <18>;
				vback-porch = <8>;
				vfront-porch = <6>;
				hsync-len = <10>;
				vsync-len = <2>;
				hsync-active = <0>;
				vsync-active = <0>;
				de-active = <0>;
				pixelclk-active = <0>;
			};
		};

	};

Rockchip RK3288 LVDS interface
================================
Required properties:
-compatible: "rockchip,rk3288-lvds";

- reg: physical base address of the controller and length

- clocks: from common clock binding: handle to dp clock.
	of memory mapped region.
- clock-names: from common clock binding: Shall be "pclk_lvds".
	pclk_lvds: for power domain, if it disable soc will power down

- rockchip,grf: this soc should set GRF regs, so need get grf here.
- rockchip,data-mapping: should be "vesa" or "jeida"
	This describes how the color bits are laid out in the
	serialized LVDS signal.

- rockchip,data-width: should be <18> or <24>

- rockchip,display: a display node as described by
	Documentation/devicetree/bindings/video/rockchip-display.txt

- rockchip,panel: required a panel node
Example:
SOC specific portion:
	lvds: lvds@ff96c000 {
		compatible = "rockchip,rk3288-lvds";
		reg = <0xff96c000 0x4000>;
		clocks = <&cru PCLK_LVDS_PHY>;
		clock-names = "pclk_lvds";

		rockchip,grf = <&grf>;
		rockchip,data-mapping = "jeida";
		rockchip,data-width = <24>;
		rockchip,panel = <&panel>
	};
```
