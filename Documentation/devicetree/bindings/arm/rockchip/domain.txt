## Documentation/devicetree/bindings/video/rockchip-vop.txt
```
device-tree bindings for rockchip soc display controller (vop)

VOP (Visual Output Processor) is the Display Controller for the Rockchip
series of SoCs which transfers the image data from a video memory
buffer to an external LCD interface.

Required properties:
- compatible: value should be one of the following
		"rockchip,rk3288-vopb";
		"rockchip,rk3288-vopl";

- interrupts: should contain a list of all VOP IP block interrupts in the
		 order: VSYNC, LCD_SYSTEM. The interrupt specifier
		 format depends on the interrupt controller used.

- clocks: must include clock specifiers corresponding to entries in the
		clock-names property.

- clock-names: Must contain
		aclk_vop: for ddr buffer transfer.
		hclk_vop: for ahb bus to R/W the phy regs.
		dclk_vop: pixel clock.

- rockchip,iommu: required a iommu node

Example:
SoC specific DT entry:
	vopb: vopb@ff930000 {
		compatible = "rockchip,rk3288-vopb";
		reg = <0xff930000 0x19c>;
		interrupts = <GIC_SPI 15 IRQ_TYPE_LEVEL_HIGH>;
		clocks = <&cru ACLK_VOP0>, <&cru DCLK_VOP0>, <&cru HCLK_VOP0>;
		clock-names = "aclk_vop", "dclk_vop", "hclk_vop";
		rockchip,iommu = <&vopb_mmu>;
	};
```

## drivers/gpu/drm/rockchip/Kconfig
```kconfig
config DRM_ROCKCHIP
	tristate "DRM Support for Rockchip"
	depends on DRM && ROCKCHIP_IOVMM
	select DRM_KMS_HELPER
	select DRM_KMS_FB_HELPER
	select DRM_PANEL
	select FB_CFB_FILLRECT
	select FB_CFB_COPYAREA
	select FB_CFB_IMAGEBLIT
	select VT_HW_CONSOLE_BINDING if FRAMEBUFFER_CONSOLE
	select VIDEOMODE_HELPERS
	help
	  Choose this option if you have a Rockchip soc chipset.
	  This driver provides kernel mode setting and buffer
	  management to userspace. This driver does not provides
	  2D or 3D acceleration; acceleration is performed by other
	  IP found on the SoC.

config ROCKCHIP_LVDS
	bool "Rockchip lvds support"
	depends on DRM_ROCKCHIP
	help
	  Choose this option if you have a Rockchip lvds.
	  Rockchip rk3288 SoC has lvds Controller can be used.
	  If you have an LVDS Panel, say Y to enable its driver.

config ROCKCHIP_EDP
	bool "Rockchip edp support"
	depends on DRM_ROCKCHIP
	help
	  Choose this option if you have a Rockchip eDP.
	  Rockchip rk3288 SoC has eDP TX Controller can be used.
	  If you have an Embedded DisplayPort Panel, say Y to enable its
	  driver.
```

## drivers/gpu/drm/rockchip/connector/Kconfig
```kconfig
config RK3288_LVDS
	bool "RK3288 lvds connector support"
	depends on DRM_ROCKCHIP_CONNECTOR
	help
	  Choose this option if you have a rk3288 lvds connector.
	  rk3288 lvds transmitter support ttl rgb, lvds and dual lvds
	  mode, dual lvds mode is support for the plane which need dual
	  lvds channels.

config RK3288_DP
	bool "RK3288 edp connector support"
	depends on DRM_ROCKCHIP_CONNECTOR
	help
	  Choose this option if you have a rk32xx eDP connector.
	  Rockchip rk3288 SoC has eDP TX Controller can be used.
	  If you have an Embedded DisplayPort Panel, say Y to enable its
	  driver.
```

## drivers/gpu/drm/rockchip/dp/Kconfig
```kconfig
config RK32XX_LVDS
	bool "RK32XX lvds transmitter support"
	depends on DRM_ROCKCHIP_DP
	help
	  Choose this option if you have a rk32xx lvds transmitter.
	  rk32xx lvds transmitter support ttl rgb, lvds and dual lvds
	  mode, dual lvds mode is support for the plane which need dual
	  lvds channels.
```

## drivers/gpu/drm/rockchip/lcdc/Kconfig
```kconfig
config LCDC_RK3288
        bool "rk3288 lcdc support"
        depends on DRM_ROCKCHIP_LCDC
        help
	  Choose this option if you have a rk3288 lcd controller.
	  rk3288 lcdc is the display interface from memory frame buffer
	  to display device. There are two lcd controllers on rk3288,
	  They have same regs setting, can use same drivers. We use the
	  lcdc id distinguish between them
```

## drivers/net/wireless/rockchip_wlan/mv8897/Kconfig
```kconfig
config MV8897
	tristate "Marvell Avastar 88W8897 WLAN Support"
	---help---
	  Help message of mv8897
```
